#include "main.h"



extern uint16_t g_VefIntAvergeVolt;


const uint32_t Risister_table[]=
{

	//K OHMS
	1792666,	//-30
	1684053,	//-29
	1582726,	//-28
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	  274,	//250
};

	uint16_t i=0;
	uint32_t risister,volt,battery;
	int16_t temp=-1000;
int16_t TempCal(uint16_t adc,uint16_t resister)
{

	 battery=g_VefIntAvergeVolt;

	 if(battery>3500)  
		battery=3300;

	 volt=(uint32_t) adc*(uint32_t)battery/(uint32_t)4096;

	 if(volt>=battery)
	 	return -1000;
	 
	 if(volt==0)
	 	return 1000;
	 
	 risister=volt*(uint32_t)resister*10/((uint32_t)battery-volt);

	for(i=0;i<sizeof(Risister_table)/4;i++)
	{
		if(risister>Risister_table[i+1]&&risister<=Risister_table[i])
			break;
		   }

	 if(i<sizeof(Risister_table)/4)
	 {
	 	temp=i-30;
	 	}

	 return temp;
}



